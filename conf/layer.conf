## conf/layer.conf
```bitbake
# We have a conf and classes directory, add to BBPATH
BBPATH .= ":${LAYERDIR}"

# We have recipes-* directories, add to BBFILES
BBFILES += "${LAYERDIR}/recipes-*/*/*.bb \
      ${LAYERDIR}/recipes-*/*/*.bbappend"

BBFILE_COLLECTIONS += "meta-embarcados"
BBFILE_PATTERN_meta-embarcados = "^${LAYERDIR}/"
BBFILE_PRIORITY_meta-embarcados = "10"
LAYERSERIES_COMPAT_meta-embarcados = "dunfell"
```
